## A1_SDK_SC235HAI_2/smartsens_sdk/smart_software/package/mouse_face_demo/Config.in
```kconfig
config BR2_PACKAGE_MOUSE_FACE_DEMO
    bool "Mouse Face Detection Demo"
    help
        Mouse face detection with quality assessment, face cropping, and grimace scoring.
```
